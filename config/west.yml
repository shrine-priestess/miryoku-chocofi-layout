## config/west.yml
```yaml
manifest:
  remotes:
    - name: zmkfirmware
      url-base: https://github.com/zmkfirmware
    - name: sgomezsal
      url-base: https://github.com/sgomezsal
    - name: urob
      url-base: https://github.com/urob
    - name: shrine-priestess
      url-base: https://github.com/shrine-priestess
  projects:
    - name: zmk
      remote: urob
      revision: v0.3
      import: app/west.yml
    - name: urchin-peripheral-animation
      remote: sgomezsal
      revision: main
    - name: zmk-helpers
      remote: urob
      revision: main
    - name: zmk-nice-view-choccy
      remote: shrine-priestess
      revision: main
  self:
    path: config
```
